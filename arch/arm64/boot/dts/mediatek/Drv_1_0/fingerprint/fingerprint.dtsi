#include "../drv_common.h"

#if PRI_CD_980S_ATA 
#include "./cd_980s_ata/cd_980s_ata.dtsi"
#endif

#if PRI_FORTSENSE_DRIVER_ALL_IN_ONE 
#include "./fortsense_driver_all_in_one/fortsense_driver_all_in_one.dtsi"
#endif

#if PRI_UDF_FORTSENSE_FS6281 
#include "./udf_fortsense_fs6281/udf_fortsense_fs6281.dtsi"
#endif

#if PRI_FOCALTECH_REE_ATA
#include "./focaltech_ree_ata/focaltech_ree_ata.dtsi"
#endif