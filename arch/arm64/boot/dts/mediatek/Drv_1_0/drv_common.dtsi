#include "./drv_common.h"

#if MODULE_FINGERPRINT
#include "./fingerprint/fingerprint.dtsi"
#endif

#if MODULE_SMART_PA
#include "./smartpa/smartpa.dtsi"
#endif

#if MODULE_TEE
#include "./tee/tee.dtsi"
#endif